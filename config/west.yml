## config/west.yml
```yaml
manifest:
  remotes:
    - name: zmkfirmware
      url-base: https://github.com/zmkfirmware
    - name: refil
      url-base: https://github.com/refil
    - name: wigmorewelsh
      url-base: https://github.com/wigmorewelsh
  projects:
    - name: zmk
      remote: wigmorewelsh
      revision: main
      import: app/west.yml
  self:
    path: config
```
